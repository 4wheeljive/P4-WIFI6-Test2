## sdkconfig.defaults
```kconfig
# Espressif IoT Development Framework (ESP-IDF) Project Configuration
# This file can be edited manually.
#
CONFIG_IDF_TARGET="esp32p4"
CONFIG_ESPTOOLPY_FLASHSIZE_16MB=y
CONFIG_ESPTOOLPY_FLASHSIZE="16MB"
CONFIG_PARTITION_TABLE_CUSTOM=y
CONFIG_PARTITION_TABLE_CUSTOM_FILENAME="partitions.csv"

# Arduino support
CONFIG_AUTOSTART_ARDUINO=y

# System
CONFIG_ESP_SYSTEM_USE_FRAME_POINTER=y
CONFIG_COMPILER_CXX_EXCEPTIONS=y
CONFIG_FREERTOS_HZ=1000

# Bluetooth Configuration (temporarily disabled to access menuconfig)
# CONFIG_BT_ENABLED=y
# CONFIG_BT_CONTROLLER_DISABLED=y
# CONFIG_BT_BLUEDROID_ENABLED=n
# CONFIG_BT_NIMBLE_ENABLED=y
# CONFIG_BT_NIMBLE_TRANSPORT_UART=n

# ESP Hosted BT (for ESP32-P4)
# Used as VHCI transport between BT Host and Controller
# CONFIG_ESP_ENABLE_BT=y
# CONFIG_ESP_HOSTED_ENABLE_BT_NIMBLE=y
# CONFIG_ESP_WIFI_REMOTE_LIBRARY_HOSTED=y
# CONFIG_SLAVE_IDF_TARGET_ESP32C6=y

# HTTP Server
CONFIG_HTTPD_MAX_REQ_HDR_LEN=800
CONFIG_HTTPD_WS_SUPPORT=y

# WiFi
CONFIG_ESP_WIFI_EXTRA_IRAM_OPT=n
CONFIG_ESP_WIFI_SLP_IRAM_OPT=n

# FAT Filesystem
CONFIG_FATFS_LFN_HEAP=y

# PSRAM Configuration
CONFIG_SPIRAM=y
CONFIG_SPIRAM_MODE_HEX=y
CONFIG_SPIRAM_SPEED_80M=y
CONFIG_SPIRAM_BOOT_INIT=y
CONFIG_SPIRAM_USE_MALLOC=y
CONFIG_SPIRAM_MEMTEST=y
CONFIG_SPIRAM_MALLOC_ALWAYSINTERNAL=16384
CONFIG_SPIRAM_MALLOC_RESERVE_INTERNAL=32768
CONFIG_SPIRAM_ALLOW_STACK_EXTERNAL_MEMORY=y
```
